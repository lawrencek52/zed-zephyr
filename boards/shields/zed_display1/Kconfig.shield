## boards/shields/zed_display1/Kconfig.shield
```kconfig
# SPDX-License-Identifier: Apache-2.0
#
# Copyright (c) 2025 Lawrence King

config SHIELD_ZED_DISPLAY1
	def_bool $(shields_list_contains,zed_display1)

config SHIELD_ZED_DISPLAY1_CON1
	def_bool $(shields_list_contains,zed_display1_con1)

config SHIELD_ZED_DISPLAY1_CON2
	def_bool $(shields_list_contains,zed_display1_con2)

config SHIELD_ZED_DISPLAY1_CON3
	def_bool $(shields_list_contains,zed_display1_con3)

config SHIELD_ZED_DISPLAY1_CON4
	def_bool $(shields_list_contains,zed_display1_con4)
```

## boards/shields/zed_sensor1/Kconfig.shield
```kconfig
# SPDX-License-Identifier: Apache-2.0
#
# Copyright (c) 2025 Lawrence King

config SHIELD_ZED_SENSOR1
	def_bool $(shields_list_contains,zed_sensor1)

config SHIELD_ZED_SENSOR1_CON1
	def_bool $(shields_list_contains,zed_sensor1_con1)

config SHIELD_ZED_SENSOR1_CON2
	def_bool $(shields_list_contains,zed_sensor1_con2)

config SHIELD_ZED_SENSOR1_CON3
	def_bool $(shields_list_contains,zed_sensor1_con3)

config SHIELD_ZED_SENSOR1_CON4
	def_bool $(shields_list_contains,zed_sensor1_con4)
```

## boards/zed-boards/zed_cpu1/board.yml
```yaml
board:
  name: zed_cpu1
  full_name: Zed Boards CPU1
  vendor: zed-boards
  socs:
  - name: 'nrf5340'
    variants:
    - name: 'ns'
      cpucluster: 'cpuapp'
```

## boards/zed-boards/zed_cpu1/zed_cpu1_nrf5340_cpuapp_defconfig
```kconfig
# SPDX-License-Identifier: Apache-2.0

# Enable MPU
CONFIG_ARM_MPU=y

# Enable TrustZone-M
CONFIG_ARM_TRUSTZONE_M=y

# enable GPIO
CONFIG_GPIO=y

# Enable uart driver
CONFIG_SERIAL=y

# enable console
CONFIG_CONSOLE=y
CONFIG_UART_CONSOLE=y

# enable i2c3 for the housekeeping
CONFIG_I2C=y
CONFIG_I2C_NRFX=y

#enable the housekeeping adcs
CONFIG_ADC=y
```
