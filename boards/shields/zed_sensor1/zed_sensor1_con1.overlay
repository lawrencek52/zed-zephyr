/*
 * SPDX-License-Identifier: Apache-2.0
 *
 * Copyright (c) 2025 Lawrence King
 */

#define ZED_CONNECTOR zed_cpu1_con1
#define I2C_DEFAULT i2c_con1_default
#define I2C_SLEEP i2c_con1_sleep
#define UART_DEFAULT uart_con1_default
#define UART_SLEEP uart_con1_sleep
#include "zed_sensor1.dtsi"
